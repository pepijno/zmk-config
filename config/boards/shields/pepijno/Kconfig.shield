## config/boards/shields/pepijno/Kconfig.shield
```kconfig
# Copyright (c) 2022 Duccio Breschi
# SPDX-License-Identifier: MIT

config SHIELD_PEPIJNO_LEFT
    def_bool $(shields_list_contains,pepijno_left)

config SHIELD_PEPIJNO_RIGHT
    def_bool $(shields_list_contains,pepijno_right)
```
